## conf/bblayers.conf
```bitbake
POKY_BBLAYERS_CONF_VERSION = "2"

BBPATH = "${TOPDIR}"
BSPDIR := "${@os.path.abspath(os.path.dirname(d.getVar('FILE', True)) + '/../..')}"

BBFILES ?= ""
BBLAYERS = " \
  ${BSPDIR}/sources/poky/meta \
  ${BSPDIR}/sources/poky/meta-poky \
  ${BSPDIR}/sources/meta-openembedded/meta-oe \
  ${BSPDIR}/sources/meta-openembedded/meta-python \
  ${BSPDIR}/sources/meta-openembedded/meta-multimedia \
  ${BSPDIR}/sources/meta-freescale \
  ${BSPDIR}/sources/meta-qt6 \
  ${BSPDIR}/sources/meta-tq/meta-tq \
  ${BSPDIR}/sources/meta-imx/meta-imx-ml \
  ${BSPDIR}/sources/meta-imx/meta-imx-sdk \
  ${BSPDIR}/sources/meta-imx/meta-imx-bsp \
  ${BSPDIR}/sources/meta-arm/meta-arm \
  ${BSPDIR}/sources/meta-arm/meta-arm-toolchain \
  ${BSPDIR}/sources/meta-freescale-distro \
  ${BSPDIR}/sources/meta-overlay \
  ${BSPDIR}/sources/meta-virtualization \
  ${BSPDIR}/sources/meta-openembedded/meta-filesystems \
  ${BSPDIR}/sources/meta-openembedded/meta-networking \
  ${BSPDIR}/sources/meta-security/meta-tpm \
  ${BSPDIR}/sources/meta-security/meta-parsec \
  ${BSPDIR}/sources/meta-clang \
  ${BSPDIR}/sources/meta-scipy \
"
```

## conf/local.conf
```bitbake
MACHINE ??= "tqma8mpxl-mba8mpxl"
DISTRO ?= "fsl-imx-wayland"
# DISTRO ?= "fsl-imx-fb"
# DISTRO ?= "poky"
PACKAGE_CLASSES ?= "package_rpm"
USER_CLASSES ?= "buildstats"
PATCHRESOLVE = "noop"
BB_DISKMON_DIRS ??= "\
    STOPTASKS,${TMPDIR},1G,100K \
    STOPTASKS,${DL_DIR},1G,100K \
    STOPTASKS,${SSTATE_DIR},1G,100K \
    STOPTASKS,/tmp,100M,100K \
    HALT,${TMPDIR},100M,1K \
    HALT,${DL_DIR},100M,1K \
    HALT,${SSTATE_DIR},100M,1K \
    HALT,/tmp,10M,1K"
PACKAGECONFIG:append:pn-qemu-system-native = " sdl"
CONF_VERSION = "2"
ACCEPT_FSL_EULA = "1"
ACCEPT_QT6_EULA = "1"
QT_EDITION = "opensource"

IMAGE_INSTALL:append = " tensorflow-lite tensorflow-lite-dbg"
IMAGE_INSTALL:append = " tvm tvm-dbg"
IMAGE_INSTALL:append = " onnxruntime onnxruntime-dbg"
DEBUG_BUILD:onnxruntime = "1"
INHIBIT_PACKAGE_STRIP:onnxruntime = "1"

IMAGE_INSTALL:append = " opencv opencv-dbg"
DEBUG_BUILD:opencv = "1"
INHIBIT_PACKAGE_STRIP:opencv = "1"

IMAGE_INSTALL:append = " tmux inetutils inetutils-tftp vim curl"
#IMAGE_INSTALL:append = " python4-scipy python3-numpy"
IMAGE_INSTALL:remove = " packagegroup-imx-ml"
# BB_DANGLINGAPPENDS_WARNONLY = "1"

# FORTRAN:forcevariable = ",fortran"
# RUNTIMETARGET:append:pn-gcc-runtime = " libquadmath"


# https://developer.ridgerun.com/wiki/index.php/Preparing_Yocto_Development_Environment_for_Debugging
# DEBUG_BUILD = "1"
BB_NUMBER_THREADS = "8"

EXTRA_IMAGE_FEATURES = " dev-pkgs tools-debug"
```

## meta-overlay/conf/layer.conf
```bitbake
# We have a conf and classes directory, add to BBPATH
BBPATH .= ":${LAYERDIR}"

# We have recipes-* directories, add to BBFILES
BBFILES += "${LAYERDIR}/recipes-*/*/*.bb \
            ${LAYERDIR}/recipes-*/*/*.bbappend"

BBFILE_COLLECTIONS += "meta-overlay"
BBFILE_PATTERN_meta-overlay = "^${LAYERDIR}/"
BBFILE_PRIORITY_meta-overlay = "10"

LAYERDEPENDS_meta-overlay = "core"
LAYERSERIES_COMPAT_meta-overlay = "scarthgap"
```
